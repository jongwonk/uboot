## board/samsung/aesop/Kconfig
```kconfig
if TARGET_S5P_AESOP

config SYS_BOARD
	default "aesop"

config SYS_VENDOR
	default "samsung"

config SYS_SOC
	default "s5pc1xx"

config SYS_CONFIG_NAME
	default "aesop"

config DM
	default y

config DM_GPIO
	default y

config DM_SERIAL
	default y

endif
```

## configs/aesop_defconfig
```kconfig
CONFIG_ARM=y
CONFIG_ARCH_S5PC1XX=y
CONFIG_TARGET_S5P_AESOP=y
CONFIG_DEFAULT_DEVICE_TREE="s5pc1xx-aesop"
CONFIG_SYS_MALLOC_F=y
CONFIG_SYS_MALLOC_F_LEN=0x400
```
